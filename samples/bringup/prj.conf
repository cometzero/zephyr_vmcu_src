## CMakeLists.txt
```
# SPDX-License-Identifier: Apache-2.0
cmake_minimum_required(VERSION 3.20.0)
find_package(Zephyr REQUIRED HINTS $ENV{ZEPHYR_BASE})
project(vmcu_bringup)
target_sources(app PRIVATE src/main.c)
```

## prj.conf
```kconfig
# SPDX-License-Identifier: Apache-2.0
CONFIG_SHELL=y
CONFIG_SHELL_BACKEND_SERIAL=y
CONFIG_SHELL_BACKEND_SERIAL_INTERRUPT_DRIVEN=n
CONFIG_SHELL_PROMPT_UART="vmcu:~$ "
CONFIG_SHELL_VT100_COLORS=n
CONFIG_MAIN_STACK_SIZE=2048
CONFIG_SHELL_STACK_SIZE=2048
CONFIG_ASSERT=y
CONFIG_THREAD_NAME=y
CONFIG_THREAD_MONITOR=y
CONFIG_INIT_STACKS=y
CONFIG_THREAD_STACK_INFO=y
```

## src/main.c
```c
/* SPDX-License-Identifier: Apache-2.0 */
#include <zephyr/kernel.h>
#include <zephyr/device.h>
#include <zephyr/drivers/uart.h>
#include <zephyr/shell/shell.h>

static int cmd_probe(const struct shell *sh, size_t argc, char **argv)
{
	ARG_UNUSED(argc);
	ARG_UNUSED(argv);
	shell_print(sh, "VMCU_ZEPHYR_PASS uptime_ms=%lld link=%s console=%s",
		    (long long)k_uptime_get(),
		    device_is_ready(DEVICE_DT_GET(DT_ALIAS(vmcu_link))) ? "ready" : "failed",
		    device_is_ready(DEVICE_DT_GET(DT_CHOSEN(zephyr_console))) ? "ready" : "failed");
	return 0;
}

SHELL_CMD_REGISTER(probe, NULL, "Probe kernel uptime and both native ASCLIN drivers", cmd_probe);

int main(void)
{
	printk("TC397 Zephyr bringup: ASCLIN0=link ASCLIN1=shell\n");
	return 0;
}
```
